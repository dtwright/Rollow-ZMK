## app/boards/shields/rollow/Kconfig.shield
```kconfig
# Copyright (c) 2020 Pete Johanson
# SPDX-License-Identifier: MIT

config SHIELD_ROLLOW_LEFT
	def_bool $(shields_list_contains,rollow_left)

config SHIELD_ROLLOW_RIGHT
	def_bool $(shields_list_contains,rollow_right)

# config LVGL_BITS_PER_PIXEL
    # default 1

# choice LVGL_COLOR_DEPTH
    # default LVGL_COLOR_DEPTH_1
# endchoice
```
